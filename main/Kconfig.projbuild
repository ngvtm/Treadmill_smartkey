## main/Kconfig.projbuild
```kconfig
menu "Example Configuration"

    config EXAMPLE_PEER_ADDR
        string "Peer Address"
        default "ADDR_ANY"
        help
            Enter the peer address in aa:bb:cc:dd:ee:ff form to connect to a specific peripheral

    config EXAMPLE_EXTENDED_ADV
        bool
        depends on SOC_BLE_50_SUPPORTED && BT_NIMBLE_50_FEATURE_SUPPORT
        default y if SOC_ESP_NIMBLE_CONTROLLER
        select BT_NIMBLE_EXT_ADV
        prompt "Enable Extended Adv"
        help
            Use this option to enable extended advertising in the example.
            If this option is disabled, ensure config BT_NIMBLE_EXT_ADV is
            also disabled from Nimble stack menuconfig

    config EXAMPLE_INIT_DEINIT_LOOP
        bool
        prompt "Perform init deinit of nimble stack in a loop"
        help
            Enable this flag, to perform only stack Init and Deinit in a loop.

    config EXAMPLE_ENCRYPTION
        bool
        prompt "Enable Link Encryption"
        help
            This enables bonding and encryption after connection has been established.

    config EXAMPLE_USE_CI_ADDRESS
        bool
        default n
        prompt "Advertise using Test address(Internal Test ONLY)"
        help
            Used for internal test ONLY.
            Use this option to advertise in a specific random address.
endmenu

menu "Smartkey Control"

    config TREADMILL_CTRL_ON_CONFIRM_TIMEOUT_MS
        int "ON confirm timeout: status must confirm ON within (ms)"
        default 2000
        range 500 10000
        help
            Phase 1, S1.2: sending ON no longer turns control on
            immediately. A status with running=1 must arrive within
            this window, or control stays OFF. No auto-retry.

    config TREADMILL_CTRL_STATUS_STALE_MS
        int "Status staleness: no status within (ms) means signal lost"
        default 2000
        range 500 10000
        help
            Phase 1, S1.2: a connected server that stops sending
            status is treated as signal lost — the display shows
            MAT TIN HIEU and control locks until a fresh status
            arrives.

    config TREADMILL_CTRL_SPEED_RATE_LIMIT_MS
        int "Speed buttons: minimum time between steps (ms)"
        default 300
        range 0 2000
        help
            Phase 1, S1.3: SPEED_UP/DOWN together allow at most one
            step per this interval, so a burst of presses cannot
            jump the speed.

    config TREADMILL_BUTTON_HOLD_START_MS
        int "Hold-to-start: toggle must be held this long to send ON (ms)"
        default 1500
        range 500 5000
        help
            Phase 1, S1.3: a quick toggle press while stopped does
            nothing; only holding the toggle sends ON. A quick press
            while running still sends OFF immediately.

    config TREADMILL_BUTTON_STUCK_MS
        int "Stuck button: held this long means stuck, ignore until release (ms)"
        default 5000
        range 1000 30000
        help
            Phase 1, S1.3: a button held past this time (or already
            pressed at boot) fires no further events until released,
            so a wedged key cannot keep stepping the speed or start
            the belt on its own.

    config TREADMILL_CTRL_RSSI_MIN_DBM
        int "RSSI start gate: refuse ON when link is weaker than (dBm)"
        default -75
        range -100 -20
        help
            Phase 1, S1.4: ON only, never OFF/reconnect/running. The
            default is deliberately loose; calibrate on real hardware
            (RSSI beside the belt vs. from the next room) and drop
            the gate if RSSI cannot tell them apart. A failed RSSI
            read fails open with a warning log.

    config TREADMILL_CTRL_ALERT_HOLD_MS
        int "Severe alert minimum on-screen time (ms)"
        default 3000
        range 0 10000
        help
            Phase 1, S1.6: once DANGER, NO_PERSON or SAFETY_KEY_OUT
            is shown, it stays at least this long even if the next
            status reports something else, so the runner can read it.
            After the window, the latest alert wins.

menu "Smartkey Touch"

    config TREADMILL_TOUCH_CS_GPIO
        int "XPT2046 chip-select GPIO"
        default 13
        range 0 39
        help
            Touch chip-select. GPIO14: non-strapping, free on the
            smartkey. Shares SCK/MOSI with the display; MISO is
            TREADMILL_TOUCH_MISO_GPIO.

    config TREADMILL_TOUCH_IRQ_GPIO
        int "XPT2046 PENIRQ GPIO (low = touched)"
        default 14
        range 0 39
        help
            Input-only GPIO39 is fine here: it only ever reads the
            touch-detect level. Polled every 20 ms, no interrupt.

    config TREADMILL_TOUCH_MISO_GPIO
        int "XPT2046 data-out (MISO) GPIO"
        default 19
        range 0 39
        help
            The display bus is created with this MISO pin so the
            touch device can share SPI2_HOST with the panel.

    config TREADMILL_MENU_HOLD_MS
        int "Header hold to open the settings menu (ms)"
        default 2000
        range 500 5000

    config TREADMILL_MENU_IDLE_TIMEOUT_S
        int "Menu auto-exit after no touch (seconds)"
        default 30
        range 5 300

endmenu

    config TREADMILL_SMARTKEY_WDT_TIMEOUT_S
        int "Task watchdog timeout for LCD/button/ctrl tasks (seconds)"
        default 2
        range 1 60
        help
            Phase 1, S1.5: the LCD, button and ctrl tick tasks must
            feed the task watchdog within this time or the key
            resets (panic). 2 s is safe here because all three loop
            in <= 1 s even when idle. Software net only — it does
            not replace the server-side hardware interlock.

endmenu

menu "Smartkey TFT Display"

    choice TFT_PANEL_DRIVER
        prompt "TFT panel driver IC (2.4 inch, 240x320, SPI)"
        default TFT_PANEL_ILI9341
        help
            The generic 2.4" 240x320 SPI modules (often marked
            v1.3, usually with XPT2046 touch fitted but unused here)
            are almost always ILI9341. If the screen stays white or
            colors look inverted after flashing, switch to ST7789 -
            no code change needed.

        config TFT_PANEL_ILI9341
            bool "ILI9341"

        config TFT_PANEL_ST7789
            bool "ST7789"

    endchoice

    config TFT_SPI_HZ
        int "TFT SPI clock (Hz)"
        default 40000000
        range 1000000 80000000
        help
            40 MHz is a safe write clock for both ILI9341 and
            ST7789 modules on short jumper wires; lower it to
            20 MHz if long wires cause noise/sparkles.

endmenu
```

## sdkconfig.defaults
```kconfig
# Override some defaults so BT stack is enabled
# in this example

#
# BT config
#
CONFIG_BT_ENABLED=y
CONFIG_BTDM_CTRL_MODE_BLE_ONLY=y
CONFIG_BTDM_CTRL_MODE_BR_EDR_ONLY=n
CONFIG_BTDM_CTRL_MODE_BTDM=n
CONFIG_BT_BLUEDROID_ENABLED=n
CONFIG_BT_NIMBLE_ENABLED=y
CONFIG_ESP32_WIFI_SW_COEXIST_ENABLE=n
CONFIG_BTDM_MODEM_SLEEP=y
```
